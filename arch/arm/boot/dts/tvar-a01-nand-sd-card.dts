/dts-v1/;

//base include for cpu
#include "imx6ull.dtsi"
//base include for variscite SOM
#include "imx6ull-var-som.dtsi"
//base include for nand-storage of variscite SOM
#include "imx6ul-imx6ull-var-som-nand.dtsi"

//#include "imx6ull-var-som-concerto-board.dtsi"
//new base file for t-var
#include "tvar-a01-base.dtsi"

//enable sd-card
#include "imx6ul-imx6ull-var-som-concerto-board-sd-card.dtsi"

/ {
	model = "VAR-SOM-6UL with i.MX6ULL, NAND flash & SD card support on T-VAR-A01";
	compatible = "variscite,imx6ul-var-som", "fsl,imx6ull";
};
