/dts-v1/;

//base include for cpu
#include "imx6ull.dtsi"
//base include for variscite SOM
#include "imx6ull-var-som.dtsi"
//base include for emmc-storage of variscite SOM
#include "imx6ul-imx6ull-var-som-emmc.dtsi"

#include "idb-a01-base.dtsi"

/ {
	model = "VAR-SOM-6UL with i.MX6ULL, eMMC on IDB-A01";
	compatible = "variscite,imx6ul-var-som", "fsl,imx6ull";
};
